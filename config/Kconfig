## config/Kconfig
```kconfig
menu "Chippy Custom Features"

config ZMK_BEHAVIOR_BT_PROFILE_REPORT
    bool "Enable BT profile text report behavior"
    default y
    help
      Enables a custom behavior that types `Profile BT <digit>` for the
      currently active Bluetooth profile.

endmenu
```

## config/dts/bindings/behaviors/zmk,behavior-bt-profile-report.yaml
```yaml
# Copyright (c) 2026
# SPDX-License-Identifier: MIT

description: Bluetooth profile text report behavior

compatible: "zmk,behavior-bt-profile-report"

include: zero_param.yaml
```
